## boards/hisilicon/bearpi_pico_h3863/Kconfig.bearpi_pico_h3863
```kconfig
# Copyright (c) 2025 Gong Zhile <gongzl@stu.hebust.edu.cn>
# SPDX-License-Identifier: Apache-2.0

config BOARD_BEARPI_PICO_H3863
	select SOC_WS63
```

## boards/hisilicon/bearpi_pico_h3863/bearpi_pico_h3863_defconfig
```kconfig
# Copyright (c) 2025 Gong Zhile <gongzl@stu.hebust.edu.cn>
# SPDX-License-Identifier: Apache-2.0

CONFIG_SYS_CLOCK_EXISTS=n
```

## boards/hisilicon/bearpi_pico_h3863/board.yml
```yaml
board:
  name: bearpi_pico_h3863
  full_name: BEARPI_PICO_H3863
  vendor: bearpi
  socs:
    - name: ws63
```

## drivers/serial/Kconfig.hisilicon
```kconfig
# Hisilicon UART configuration

# Copyright (c) 2025 Gong Zhile <gongzl@stu.hebust.edu.cn>
# SPDX-License-Identifier: Apache-2.0

config UART_HISILICON_V151
	bool "HISILICON V151 UART"
	default y
	depends on DT_HAS_HISILICON_V151_UART_ENABLED
	select SERIAL_HAS_DRIVER
	help
	  This option enables the UART driver for the HISILICON V151.
```

## drivers/watchdog/Kconfig.hisilicon
```kconfig
# Copyright (c) 2025, Gong Zhile
# SPDX-License-Identifier: Apache-2.0

config WDT_HISILICON_V151
       bool "Hisilicon v151 Watchdog driver"
       default y
       depends on DT_HAS_HISILICON_V151_WATCHDOG_ENABLED
       select HAS_WDT_DISABLE_AT_BOOT
       select HAS_WDT_NO_CALLBACKS
```

## dts/bindings/serial/hisilicon,v151-uart.yaml
```yaml
description: HISILICON V151 UART

compatible: "hisilicon,v151-uart"

include: uart-controller.yaml

properties:
  reg:
    required: true
```

## dts/bindings/watchdog/hisilicon,v151-watchdog.yaml
```yaml
# Copyright (c) 2025, Gong Zhile
# SPDX-License-Identifier: Apache-2.0

description: Hisilicon v151 Watchdog

compatible: "hisilicon,v151-watchdog"

include: base.yaml

properties:
  reg:
    required: true

  # clocks:
  #   required: true
  #   description: Crystal oscillator source clock
```

## soc/hisilicon/ws63/Kconfig
```kconfig
# Copyright (c) 2025 Gong Zhile <gongzl@stu.hebust.edu.cn>
# SPDX-License-Identifier: Apache-2.0

config SOC_WS63
	select RISCV
	select RISCV_ISA_EXT_M
	select RISCV_ISA_EXT_F
	select RISCV_ISA_EXT_C
	select RISCV_PRIVILEGED
	select RISCV_SOC_HAS_GP_RELATIVE_ADDRESSING
	select RISCV_ISA_EXT_ZICSR
	imply XIP
```

## soc/hisilicon/ws63/Kconfig.defconfig
```kconfig
# Copyright (c) 2025 Gong Zhile <gongzl@stu.hebust.edu.cn>
# SPDX-License-Identifier: Apache-2.0

if SOC_WS63

config NUM_IRQS
	default 73

endif # SOC_WS63
```

## soc/hisilicon/ws63/Kconfig.soc
```kconfig
# Copyright (c) 2025 Gong Zhile <gongzl@stu.hebust.edu.cn>
# SPDX-License-Identifier: Apache-2.0

config SOC_WS63
	bool

config SOC
	default "ws63" if SOC_WS63
```
