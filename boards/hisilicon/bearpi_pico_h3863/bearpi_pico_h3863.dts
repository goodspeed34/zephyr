/*
 * Copyright (c) 2025 Gong Zhile <gongzl@stu.hebust.edu.cn>
 *
 * SPDX-License-Identifier: Apache-2.0
*/

/dts-v1/;

#include <hisilicon/ws63.dtsi>

/ {
	model = "Bearpi-Pico H3863";

	chosen {
		zephyr,sram = &sram0;
		zephyr,flash = &flash0;
		zephyr,console = &uart0;
	};
};
